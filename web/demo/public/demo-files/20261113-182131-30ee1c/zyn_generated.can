/*@!Encoding:1252*/
/* Test cases generated by Zyn Anvil, run 20261113-182131-30ee1c. Zyn prototype.
   Not run against any hardware or simulator here. For a CANoe test module with the
   CAN database loaded, so $Signal refers to its signals.
   Open values were assumed by the generator; replace them before relying on a result.
   Implement the three functions below for your setup; until then they fail the step. */

includes
{
}

variables
{
}

void ZynStopMessage(char message[])
{
  testStepFail("not implemented", "Stop sending %s: switch off its node or message in your simulation.", message);
}

int ZynCheckPeriod(char message[], long periodMs, long toleranceMs, long count)
{
  testStepFail("not implemented", "Measure %d intervals of %s and compare with %d ms +/- %d ms.", count, message, periodMs, toleranceMs);
  return 0;
}

int ZynValueAfterInRange(char what[])
{
  testStepFail("not implemented", "Range check for %s needs your measurement access.", what);
  return 0;
}

/* TC-REQ-COM-001-01: Manual check
   Oracle (REQ-COM-001): 10.1 The cluster shall communicate on the powertrain CAN bus at a bit rate of 500 kbit/s.
   Expected: Connect a CAN analyzer or oscilloscope to the powertrain CAN bus and measure the bit time of frames sent by the cluster (2 µs per bit for 500 kbit/s). Confirm the cluster communicates without error fr */
testcase TC_REQ_COM_001_01()
{
  long zt;
  int zok;
  testCaseTitle("TC-REQ-COM-001-01", "Manual check");
  testCaseComment("Manual check: Connect a CAN analyzer or oscilloscope to the powertrain CAN bus and measure the bit time of frames sent by the cluster (2 µs per bit for 500 kbit/s). Confirm the cluster communicates without error fr");
  testStepPass("manual", "Not automated; checked by a person.");
}

/* TC-REQ-COM-004-01: Manual check
   Oracle (REQ-COM-004): 10.4 After a bus-off event, the cluster shall attempt recovery as specified in the network management document.
   Expected: Force a bus-off on the cluster with a CAN fault-injection tool, such as a short of CAN-H to CAN-L or error-frame injection. Then confirm with a bus trace that the cluster resumes transmitting ClusterS */
testcase TC_REQ_COM_004_01()
{
  long zt;
  int zok;
  testCaseTitle("TC-REQ-COM-004-01", "Manual check");
  testCaseComment("Manual check: Force a bus-off on the cluster with a CAN fault-injection tool, such as a short of CAN-H to CAN-L or error-frame injection. Then confirm with a bus trace that the cluster resumes transmitting ClusterS");
  testStepPass("manual", "Not automated; checked by a person.");
}

/* TC-REQ-GAUGE-006-01: Manual check
   Oracle (REQ-GAUGE-006): 5.1 The cluster shall display engine speed from the EngineSpeed signal as a needle on a scale from 0 to 8000 rpm.
   Expected: Drive EngineSpeed on the bench at several values (for example 0, 1000, 4000, 8000 rpm) and visually check that the tachometer needle points to the matching value on the 0 to 8000 rpm scale. */
testcase TC_REQ_GAUGE_006_01()
{
  long zt;
  int zok;
  testCaseTitle("TC-REQ-GAUGE-006-01", "Manual check");
  testCaseComment("Manual check: Drive EngineSpeed on the bench at several values (for example 0, 1000, 4000, 8000 rpm) and visually check that the tachometer needle points to the matching value on the 0 to 8000 rpm scale.");
  testStepPass("manual", "Not automated; checked by a person.");
}

/* TC-REQ-GAUGE-007-01: Manual check
   Oracle (REQ-GAUGE-007): 5.2 The red zone of the scale shall start at the value given by the configuration parameter RedlineRpm.
   Expected: Set RedlineRpm to a known value in the cluster configuration, then visually check that the red zone of the tachometer scale starts exactly at that rpm mark; repeat with a second configured value. */
testcase TC_REQ_GAUGE_007_01()
{
  long zt;
  int zok;
  testCaseTitle("TC-REQ-GAUGE-007-01", "Manual check");
  testCaseComment("Manual check: Set RedlineRpm to a known value in the cluster configuration, then visually check that the red zone of the tachometer scale starts exactly at that rpm mark; repeat with a second configured value.");
  testStepPass("manual", "Not automated; checked by a person.");
}

/* TC-REQ-GAUGE-008-01: Manual check
   Oracle (REQ-GAUGE-008): The cluster shall display the fuel level as a bar graph with eight segments.
   Expected: Step FuelLevel from 0 to 100 % on a HIL bench and visually confirm the gauge is drawn as a bar graph with exactly eight segments that fill up as the level rises; compare with FuelBarSegments once a le */
testcase TC_REQ_GAUGE_008_01()
{
  long zt;
  int zok;
  testCaseTitle("TC-REQ-GAUGE-008-01", "Manual check");
  testCaseComment("Manual check: Step FuelLevel from 0 to 100 % on a HIL bench and visually confirm the gauge is drawn as a bar graph with exactly eight segments that fill up as the level rises; compare with FuelBarSegments once a le");
  testStepPass("manual", "Not automated; checked by a person.");
}

/* TC-REQ-GAUGE-009-01: Manual check
   Oracle (REQ-GAUGE-009): The fuel level display shall be filtered so that it does not fluctuate when the vehicle is driving on an incline.
   Expected: Feed FuelLevel with a slow oscillation around a constant mean (simulating incline or slosh) and watch whether the fuel bar or FuelBarSegments stays steady; repeat in a vehicle on a grade. */
testcase TC_REQ_GAUGE_009_01()
{
  long zt;
  int zok;
  testCaseTitle("TC-REQ-GAUGE-009-01", "Manual check");
  testCaseComment("Manual check: Feed FuelLevel with a slow oscillation around a constant mean (simulating incline or slosh) and watch whether the fuel bar or FuelBarSegments stays steady; repeat in a vehicle on a grade.");
  testStepPass("manual", "Not automated; checked by a person.");
}

/* TC-REQ-GAUGE-010-01: FuelLevel one step below 10
   Oracle (REQ-GAUGE-010): When the fuel level is below 10 percent, the low-fuel telltale shall be lit.
   Expected: TT_LowFuel = 1 within 300 ms */
testcase TC_REQ_GAUGE_010_01()
{
  long zt;
  int zok;
  testCaseTitle("TC-REQ-GAUGE-010-01", "FuelLevel one step below 10");
  testCaseComment("Open value: reaction time not stated; cases allow 300 ms (two status cycles plus one input cycle)");
  $FuelLevel = 15;
  testWaitForTimeout(500);
  $FuelLevel = 9.5;
  if (testWaitForSignalMatch(TT_LowFuel, 1, 300) == 1)
    testStepPass("check", "TT_LowFuel = 1 within 300 ms");
  else
    testStepFail("check", "TT_LowFuel did not reach 1 within 300 ms");
}

/* TC-REQ-GAUGE-010-02: FuelLevel exactly 10
   Oracle (REQ-GAUGE-010): When the fuel level is below 10 percent, the low-fuel telltale shall be lit.
   Expected: TT_LowFuel stays 0 for 300 ms */
testcase TC_REQ_GAUGE_010_02()
{
  long zt;
  int zok;
  testCaseTitle("TC-REQ-GAUGE-010-02", "FuelLevel exactly 10");
  testCaseComment("Open value: reaction time not stated; cases allow 300 ms (two status cycles plus one input cycle)");
  $FuelLevel = 15;
  testWaitForTimeout(500);
  $FuelLevel = 10;
  zok = 1;
  for (zt = 0; zt <= 300; zt += 10) { if (!($TT_LowFuel == 0)) zok = 0; testWaitForTimeout(10); }
  if (zok) testStepPass("check", "TT_LowFuel == 0 for 300 ms");
  else testStepFail("check", "TT_LowFuel == 0 did not hold for 300 ms");
}

/* TC-REQ-GAUGE-010-03: FuelLevel one step on the other side
   Oracle (REQ-GAUGE-010): When the fuel level is below 10 percent, the low-fuel telltale shall be lit.
   Expected: TT_LowFuel stays 0 for 300 ms */
testcase TC_REQ_GAUGE_010_03()
{
  long zt;
  int zok;
  testCaseTitle("TC-REQ-GAUGE-010-03", "FuelLevel one step on the other side");
  testCaseComment("Open value: reaction time not stated; cases allow 300 ms (two status cycles plus one input cycle)");
  $FuelLevel = 15;
  testWaitForTimeout(500);
  $FuelLevel = 10.5;
  zok = 1;
  for (zt = 0; zt <= 300; zt += 10) { if (!($TT_LowFuel == 0)) zok = 0; testWaitForTimeout(10); }
  if (zok) testStepPass("check", "TT_LowFuel == 0 for 300 ms");
  else testStepFail("check", "TT_LowFuel == 0 did not hold for 300 ms");
}

/* TC-REQ-GAUGE-010-04: FuelLevel at range limit 0
   Oracle (REQ-GAUGE-010): When the fuel level is below 10 percent, the low-fuel telltale shall be lit.
   Expected: TT_LowFuel = 1 within 300 ms */
testcase TC_REQ_GAUGE_010_04()
{
  long zt;
  int zok;
  testCaseTitle("TC-REQ-GAUGE-010-04", "FuelLevel at range limit 0");
  testCaseComment("Open value: reaction time not stated; cases allow 300 ms (two status cycles plus one input cycle)");
  $FuelLevel = 15;
  testWaitForTimeout(500);
  $FuelLevel = 0;
  if (testWaitForSignalMatch(TT_LowFuel, 1, 300) == 1)
    testStepPass("check", "TT_LowFuel = 1 within 300 ms");
  else
    testStepFail("check", "TT_LowFuel did not reach 1 within 300 ms");
}

/* TC-REQ-GEN-001-01: Manual check
   Oracle (REQ-GEN-001): 15.1 The cluster shall display the first frame within 2 s of power-up.
   Expected: Apply supply power to the cluster while a high-speed camera films the display and a scope logs the supply line; measure the time from power-up to the first visible frame and check it is within 2 s ('w */
testcase TC_REQ_GEN_001_01()
{
  long zt;
  int zok;
  testCaseTitle("TC-REQ-GEN-001-01", "Manual check");
  testCaseComment("Manual check: Apply supply power to the cluster while a high-speed camera films the display and a scope logs the supply line; measure the time from power-up to the first visible frame and check it is within 2 s ('w");
  testStepPass("manual", "Not automated; checked by a person.");
}

/* TC-REQ-GEN-002-01: Manual check
   Oracle (REQ-GEN-002): 15.2 The graphics shall run smoothly at all times.
   Expected: Film the display with a high-speed camera during speed and RPM sweeps and visual-heavy scenarios; review for stutter and dropped frames, and ask for a measurable frame-rate criterion. */
testcase TC_REQ_GEN_002_01()
{
  long zt;
  int zok;
  testCaseTitle("TC-REQ-GEN-002-01", "Manual check");
  testCaseComment("Manual check: Film the display with a high-speed camera during speed and RPM sweeps and visual-heavy scenarios; review for stutter and dropped frames, and ask for a measurable frame-rate criterion.");
  testStepPass("manual", "Not automated; checked by a person.");
}

/* TC-REQ-GEN-003-01: Manual check
   Oracle (REQ-GEN-003): 15.3 CPU load shall not exceed 70 percent averaged over any 1 s window.
   Expected: Run worst-case bus load and display scenarios while measuring CPU load with a debugger/trace or OS profiling tool; compute the average over every sliding 1 s window and check it never exceeds 70 perce */
testcase TC_REQ_GEN_003_01()
{
  long zt;
  int zok;
  testCaseTitle("TC-REQ-GEN-003-01", "Manual check");
  testCaseComment("Manual check: Run worst-case bus load and display scenarios while measuring CPU load with a debugger/trace or OS profiling tool; compute the average over every sliding 1 s window and check it never exceeds 70 perce");
  testStepPass("manual", "Not automated; checked by a person.");
}

/* TC-REQ-INP-002-01: Manual check
   Oracle (REQ-INP-002): A long press of the OK button for more than 2 s shall reset the selected trip counter.
   Expected: On a bench cluster with a known trip value, select a trip counter. Press OK for clearly less than 2 s and check the counter is not reset. Then press OK for clearly more than 2 s and check on the displ */
testcase TC_REQ_INP_002_01()
{
  long zt;
  int zok;
  testCaseTitle("TC-REQ-INP-002-01", "Manual check");
  testCaseComment("Manual check: On a bench cluster with a known trip value, select a trip counter. Press OK for clearly less than 2 s and check the counter is not reset. Then press OK for clearly more than 2 s and check on the displ");
  testStepPass("manual", "Not automated; checked by a person.");
}

/* TC-REQ-PWR-001-01: IGN 0 -> 1
   Oracle (REQ-PWR-001): 3.1 The cluster shall enter the ACTIVE state within 1.5 s of IGN changing from OFF to ON.
   Expected: ClusterState = 1 within 1500 ms */
testcase TC_REQ_PWR_001_01()
{
  long zt;
  int zok;
  testCaseTitle("TC-REQ-PWR-001-01", "IGN 0 -> 1");
  $IGN = 0;
  testWaitForTimeout(500);
  $IGN = 1;
  if (testWaitForSignalMatch(ClusterState, 1, 1500) == 1)
    testStepPass("check", "ClusterState = 1 within 1500 ms");
  else
    testStepFail("check", "ClusterState did not reach 1 within 1500 ms");
}

/* TC-REQ-PWR-001-02: No IGN change
   Oracle (REQ-PWR-001): 3.1 The cluster shall enter the ACTIVE state within 1.5 s of IGN changing from OFF to ON.
   Expected: ClusterState never shows 1 for 1500 ms */
testcase TC_REQ_PWR_001_02()
{
  long zt;
  int zok;
  testCaseTitle("TC-REQ-PWR-001-02", "No IGN change");
  $IGN = 0;
  testWaitForTimeout(500);
  zok = 1;
  for (zt = 0; zt <= 1500; zt += 10) { if (!($ClusterState != 1)) zok = 0; testWaitForTimeout(10); }
  if (zok) testStepPass("check", "ClusterState != 1 for 1500 ms");
  else testStepFail("check", "ClusterState != 1 did not hold for 1500 ms");
}

/* TC-REQ-PWR-004-01: Manual check
   Oracle (REQ-PWR-004): 3.3 In the SLEEP state, the cluster shall draw no more than 0.1 mA from the battery supply.
   Expected: Bring the cluster into SLEEP (IGN OFF, wait until after the goodbye phase). Measure the battery supply current with a precision ammeter or power analyzer over a settled period. Verify it does not exce */
testcase TC_REQ_PWR_004_01()
{
  long zt;
  int zok;
  testCaseTitle("TC-REQ-PWR-004-01", "Manual check");
  testCaseComment("Manual check: Bring the cluster into SLEEP (IGN OFF, wait until after the goodbye phase). Measure the battery supply current with a precision ammeter or power analyzer over a settled period. Verify it does not exce");
  testStepPass("manual", "Not automated; checked by a person.");
}

/* TC-REQ-SEC-001-01: Manual check
   Oracle (REQ-SEC-001): 13.1 Diagnostic services that write memory shall require successful security access authentication.
   Expected: With a diagnostic tester, send a write-memory request (e.g. WriteDataByIdentifier / WriteMemoryByAddress) without security access and confirm a negative response (security access denied). Then unlock  */
testcase TC_REQ_SEC_001_01()
{
  long zt;
  int zok;
  testCaseTitle("TC-REQ-SEC-001-01", "Manual check");
  testCaseComment("Manual check: With a diagnostic tester, send a write-memory request (e.g. WriteDataByIdentifier / WriteMemoryByAddress) without security access and confirm a negative response (security access denied). Then unlock ");
  testStepPass("manual", "Not automated; checked by a person.");
}

/* TC-REQ-SEC-002-01: Manual check
   Oracle (REQ-SEC-002): 13.2 The cluster shall protect cryptographic keys appropriately.
   Expected: Clarify the requirement with the security team (e.g. keys stored in an HSM / secure storage, not readable via debug or diagnostics). Then do a security review and penetration test: try to read keys vi */
testcase TC_REQ_SEC_002_01()
{
  long zt;
  int zok;
  testCaseTitle("TC-REQ-SEC-002-01", "Manual check");
  testCaseComment("Manual check: Clarify the requirement with the security team (e.g. keys stored in an HSM / secure storage, not readable via debug or diagnostics). Then do a security review and penetration test: try to read keys vi");
  testStepPass("manual", "Not automated; checked by a person.");
}

/* TC-REQ-TT-001-01: BrakeWarn 0 -> 1
   Oracle (REQ-TT-001): | Brake system warning | BrakeWarn = 1 | Red | Steady on |
   Expected: TT_Brake = 1 within 300 ms */
testcase TC_REQ_TT_001_01()
{
  long zt;
  int zok;
  testCaseTitle("TC-REQ-TT-001-01", "BrakeWarn 0 -> 1");
  testCaseComment("Open value: reaction time not stated; cases allow 300 ms (two status cycles plus one input cycle)");
  $BrakeWarn = 0;
  testWaitForTimeout(500);
  $BrakeWarn = 1;
  if (testWaitForSignalMatch(TT_Brake, 1, 300) == 1)
    testStepPass("check", "TT_Brake = 1 within 300 ms");
  else
    testStepFail("check", "TT_Brake did not reach 1 within 300 ms");
}

/* TC-REQ-TT-001-02: No BrakeWarn change
   Oracle (REQ-TT-001): | Brake system warning | BrakeWarn = 1 | Red | Steady on |
   Expected: TT_Brake stays 0 */
testcase TC_REQ_TT_001_02()
{
  long zt;
  int zok;
  testCaseTitle("TC-REQ-TT-001-02", "No BrakeWarn change");
  testCaseComment("Open value: reaction time not stated; cases allow 300 ms (two status cycles plus one input cycle)");
  $BrakeWarn = 0;
  testWaitForTimeout(500);
  zok = 1;
  for (zt = 0; zt <= 300; zt += 10) { if (!($TT_Brake == 0)) zok = 0; testWaitForTimeout(10); }
  if (zok) testStepPass("check", "TT_Brake == 0 for 300 ms");
  else testStepFail("check", "TT_Brake == 0 did not hold for 300 ms");
}

/* TC-REQ-TT-003-01: FuelLow 0 -> 1
   Oracle (REQ-TT-003): | Low fuel | FuelLow = 1 | Amber | Steady on |
   Expected: TT_LowFuel = 1 within 300 ms */
testcase TC_REQ_TT_003_01()
{
  long zt;
  int zok;
  testCaseTitle("TC-REQ-TT-003-01", "FuelLow 0 -> 1");
  testCaseComment("Open value: reaction time not stated; cases allow 300 ms (two status cycles plus one input cycle)");
  $FuelLow = 0;
  testWaitForTimeout(500);
  $FuelLow = 1;
  if (testWaitForSignalMatch(TT_LowFuel, 1, 300) == 1)
    testStepPass("check", "TT_LowFuel = 1 within 300 ms");
  else
    testStepFail("check", "TT_LowFuel did not reach 1 within 300 ms");
}

/* TC-REQ-TT-003-02: No FuelLow change
   Oracle (REQ-TT-003): | Low fuel | FuelLow = 1 | Amber | Steady on |
   Expected: TT_LowFuel stays 0 */
testcase TC_REQ_TT_003_02()
{
  long zt;
  int zok;
  testCaseTitle("TC-REQ-TT-003-02", "No FuelLow change");
  testCaseComment("Open value: reaction time not stated; cases allow 300 ms (two status cycles plus one input cycle)");
  $FuelLow = 0;
  testWaitForTimeout(500);
  zok = 1;
  for (zt = 0; zt <= 300; zt += 10) { if (!($TT_LowFuel == 0)) zok = 0; testWaitForTimeout(10); }
  if (zok) testStepPass("check", "TT_LowFuel == 0 for 300 ms");
  else testStepFail("check", "TT_LowFuel == 0 did not hold for 300 ms");
}

/* TC-REQ-TT-004-01: MIL 0 -> 1
   Oracle (REQ-TT-004): | Engine malfunction | MIL = 1 | Amber | Steady on |
   Expected: TT_MIL = 1 within 300 ms */
testcase TC_REQ_TT_004_01()
{
  long zt;
  int zok;
  testCaseTitle("TC-REQ-TT-004-01", "MIL 0 -> 1");
  testCaseComment("Open value: reaction time not stated; cases allow 300 ms (two status cycles plus one input cycle)");
  $MIL = 0;
  testWaitForTimeout(500);
  $MIL = 1;
  if (testWaitForSignalMatch(TT_MIL, 1, 300) == 1)
    testStepPass("check", "TT_MIL = 1 within 300 ms");
  else
    testStepFail("check", "TT_MIL did not reach 1 within 300 ms");
}

/* TC-REQ-TT-004-02: No MIL change
   Oracle (REQ-TT-004): | Engine malfunction | MIL = 1 | Amber | Steady on |
   Expected: TT_MIL stays 0 */
testcase TC_REQ_TT_004_02()
{
  long zt;
  int zok;
  testCaseTitle("TC-REQ-TT-004-02", "No MIL change");
  testCaseComment("Open value: reaction time not stated; cases allow 300 ms (two status cycles plus one input cycle)");
  $MIL = 0;
  testWaitForTimeout(500);
  zok = 1;
  for (zt = 0; zt <= 300; zt += 10) { if (!($TT_MIL == 0)) zok = 0; testWaitForTimeout(10); }
  if (zok) testStepPass("check", "TT_MIL == 0 for 300 ms");
  else testStepFail("check", "TT_MIL == 0 did not hold for 300 ms");
}

/* TC-REQ-TT-005-01: IGN 0 -> 1
   Oracle (REQ-TT-005): At each transition to the ACTIVE state, all telltales in Table 1 shall be lit for 2 s as a bulb check.
   Expected: TT_Brake = 1 within 300 ms */
testcase TC_REQ_TT_005_01()
{
  long zt;
  int zok;
  testCaseTitle("TC-REQ-TT-005-01", "IGN 0 -> 1");
  testCaseComment("Open value: reaction time not stated; cases allow 300 ms (two status cycles plus one input cycle)");
  $IGN = 0;
  testWaitForTimeout(500);
  $IGN = 1;
  if (testWaitForSignalMatch(TT_Brake, 1, 300) == 1)
    testStepPass("check", "TT_Brake = 1 within 300 ms");
  else
    testStepFail("check", "TT_Brake did not reach 1 within 300 ms");
}

/* TC-REQ-TT-005-02: TT_Brake holds for 2000 ms
   Oracle (REQ-TT-005): At each transition to the ACTIVE state, all telltales in Table 1 shall be lit for 2 s as a bulb check.
   Expected: TT_Brake = 1 for 2000 ms, then ends */
testcase TC_REQ_TT_005_02()
{
  long zt;
  int zok;
  testCaseTitle("TC-REQ-TT-005-02", "TT_Brake holds for 2000 ms");
  testCaseComment("Open value: reaction time not stated; cases allow 300 ms (two status cycles plus one input cycle)");
  $IGN = 0;
  testWaitForTimeout(500);
  $IGN = 1;
  testWaitForTimeout(300);
  zok = 1;
  for (zt = 0; zt <= 1600; zt += 10) { if (!($TT_Brake == 1)) zok = 0; testWaitForTimeout(10); }
  if (zok) testStepPass("check", "TT_Brake == 1 for 1600 ms");
  else testStepFail("check", "TT_Brake == 1 did not hold for 1600 ms");
  testWaitForTimeout(400);
  if (testWaitForSignalMatch(TT_Brake, 0, 200) == 1)
    testStepPass("check", "TT_Brake = 0 within 200 ms");
  else
    testStepFail("check", "TT_Brake did not reach 0 within 200 ms");
}

/* TC-REQ-TT-005-03: No IGN change
   Oracle (REQ-TT-005): At each transition to the ACTIVE state, all telltales in Table 1 shall be lit for 2 s as a bulb check.
   Expected: TT_Brake stays 0 */
testcase TC_REQ_TT_005_03()
{
  long zt;
  int zok;
  testCaseTitle("TC-REQ-TT-005-03", "No IGN change");
  testCaseComment("Open value: reaction time not stated; cases allow 300 ms (two status cycles plus one input cycle)");
  $IGN = 0;
  testWaitForTimeout(500);
  zok = 1;
  for (zt = 0; zt <= 300; zt += 10) { if (!($TT_Brake == 0)) zok = 0; testWaitForTimeout(10); }
  if (zok) testStepPass("check", "TT_Brake == 0 for 300 ms");
  else testStepFail("check", "TT_Brake == 0 did not hold for 300 ms");
}

/* TC-REQ-TT-006-01: Manual check
   Oracle (REQ-TT-006): Red telltales shall have priority over amber telltales.
   Expected: Activate a red telltale (BrakeWarn = 1) and an amber telltale (MIL = 1) at the same time and visually check on the cluster that the red telltale is given priority as defined in the display specificati */
testcase TC_REQ_TT_006_01()
{
  long zt;
  int zok;
  testCaseTitle("TC-REQ-TT-006-01", "Manual check");
  testCaseComment("Manual check: Activate a red telltale (BrakeWarn = 1) and an amber telltale (MIL = 1) at the same time and visually check on the cluster that the red telltale is given priority as defined in the display specificati");
  testStepPass("manual", "Not automated; checked by a person.");
}

/* TC-REQ-TT-007-01: Warnings silent just under 500 ms
   Oracle (REQ-TT-007): A telltale whose input signal has not been received for more than 500 ms shall be lit
   Expected: TT_Brake stays 0 for 400 ms */
testcase TC_REQ_TT_007_01()
{
  long zt;
  int zok;
  testCaseTitle("TC-REQ-TT-007-01", "Warnings silent just under 500 ms");
  testWaitForTimeout(500);
  ZynStopMessage("Warnings");
  zok = 1;
  for (zt = 0; zt <= 400; zt += 10) { if (!($TT_Brake == 0)) zok = 0; testWaitForTimeout(10); }
  if (zok) testStepPass("check", "TT_Brake == 0 for 400 ms");
  else testStepFail("check", "TT_Brake == 0 did not hold for 400 ms");
}

/* TC-REQ-TT-007-02: Warnings silent past 500 ms
   Oracle (REQ-TT-007): A telltale whose input signal has not been received for more than 500 ms shall be lit
   Expected: TT_Brake = 1 within 200 ms after the timeout */
testcase TC_REQ_TT_007_02()
{
  long zt;
  int zok;
  testCaseTitle("TC-REQ-TT-007-02", "Warnings silent past 500 ms");
  testCaseComment("Open value: reaction after the timeout not stated; cases allow 200 ms (two status cycles)");
  testWaitForTimeout(500);
  ZynStopMessage("Warnings");
  testWaitForTimeout(500);
  if (testWaitForSignalMatch(TT_Brake, 1, 200) == 1)
    testStepPass("check", "TT_Brake = 1 within 200 ms");
  else
    testStepFail("check", "TT_Brake did not reach 1 within 200 ms");
}

/* TC-REQ-UPD-001-01: Manual check
   Oracle (REQ-UPD-001): 12.1 The cluster software shall be updatable through the diagnostic connector.
   Expected: Connect a diagnostic tester to the diagnostic connector and flash a new, validly signed software version. Then read the software version identifier with the tester and confirm that it matches the new  */
testcase TC_REQ_UPD_001_01()
{
  long zt;
  int zok;
  testCaseTitle("TC-REQ-UPD-001-01", "Manual check");
  testCaseComment("Manual check: Connect a diagnostic tester to the diagnostic connector and flash a new, validly signed software version. Then read the software version identifier with the tester and confirm that it matches the new ");
  testStepPass("manual", "Not automated; checked by a person.");
}

/* TC-REQ-UPD-002-01: Manual check
   Oracle (REQ-UPD-002): 12.2 A software update shall be accepted only if its digital signature is valid.
   Expected: Use a diagnostic tester to attempt one update with a validly signed image and one with an invalid or tampered signature. Confirm that only the validly signed image is installed, using the software ver */
testcase TC_REQ_UPD_002_01()
{
  long zt;
  int zok;
  testCaseTitle("TC-REQ-UPD-002-01", "Manual check");
  testCaseComment("Manual check: Use a diagnostic tester to attempt one update with a validly signed image and one with an invalid or tampered signature. Confirm that only the validly signed image is installed, using the software ver");
  testStepPass("manual", "Not automated; checked by a person.");
}

/* TC-REQ-UPD-003-01: Manual check
   Oracle (REQ-UPD-003): 12.3 If an update fails, the cluster shall return to the previously installed software version.
   Expected: Note the installed software version. Start an update with a diagnostic tester and interrupt it, e.g. by disconnecting power or the tester mid-transfer, or by sending a corrupted image. Restart the clu */
testcase TC_REQ_UPD_003_01()
{
  long zt;
  int zok;
  testCaseTitle("TC-REQ-UPD-003-01", "Manual check");
  testCaseComment("Manual check: Note the installed software version. Start an update with a diagnostic tester and interrupt it, e.g. by disconnecting power or the tester mid-transfer, or by sending a corrupted image. Restart the clu");
  testStepPass("manual", "Not automated; checked by a person.");
}

/* TC-REQ-AUD-001-01: BeltUnfastened 0 -> 1
   Oracle (REQ-AUD-001): 8.1 The cluster shall play the seat belt chime while the seat belt reminder telltale is flashing.
   Expected: ChimeActive = 1 within 300 ms */
testcase TC_REQ_AUD_001_01()
{
  long zt;
  int zok;
  testCaseTitle("TC-REQ-AUD-001-01", "BeltUnfastened 0 -> 1");
  testCaseComment("Open value: reaction time not stated; cases allow 300 ms (two status cycles plus one input cycle)");
  $BeltUnfastened = 0;
  testWaitForTimeout(500);
  $BeltUnfastened = 1;
  if (testWaitForSignalMatch(ChimeActive, 1, 300) == 1)
    testStepPass("check", "ChimeActive = 1 within 300 ms");
  else
    testStepFail("check", "ChimeActive did not reach 1 within 300 ms");
}

/* TC-REQ-AUD-001-02: No BeltUnfastened change
   Oracle (REQ-AUD-001): 8.1 The cluster shall play the seat belt chime while the seat belt reminder telltale is flashing.
   Expected: ChimeActive stays 0 */
testcase TC_REQ_AUD_001_02()
{
  long zt;
  int zok;
  testCaseTitle("TC-REQ-AUD-001-02", "No BeltUnfastened change");
  testCaseComment("Open value: reaction time not stated; cases allow 300 ms (two status cycles plus one input cycle)");
  $BeltUnfastened = 0;
  testWaitForTimeout(500);
  zok = 1;
  for (zt = 0; zt <= 300; zt += 10) { if (!($ChimeActive == 0)) zok = 0; testWaitForTimeout(10); }
  if (zok) testStepPass("check", "ChimeActive == 0 for 300 ms");
  else testStepFail("check", "ChimeActive == 0 did not hold for 300 ms");
}

/* TC-REQ-DIAG-001-01: Manual check
   Oracle (REQ-DIAG-001): The cluster shall store a DTC when the display backlight driver reports a fault.
   Expected: Induce a backlight driver fault on the bench (e.g. open the backlight LED string or use fault injection hardware), then read the fault memory with a diagnostic tester and check that the expected DTC i */
testcase TC_REQ_DIAG_001_01()
{
  long zt;
  int zok;
  testCaseTitle("TC-REQ-DIAG-001-01", "Manual check");
  testCaseComment("Manual check: Induce a backlight driver fault on the bench (e.g. open the backlight LED string or use fault injection hardware), then read the fault memory with a diagnostic tester and check that the expected DTC i");
  testStepPass("manual", "Not automated; checked by a person.");
}

/* TC-REQ-DIAG-002-01: Manual check
   Oracle (REQ-DIAG-002): Stored DTCs shall be readable by a diagnostic tester.
   Expected: With at least one known DTC stored, connect a diagnostic tester, issue a read-DTC request and check that the stored DTCs are returned correctly. */
testcase TC_REQ_DIAG_002_01()
{
  long zt;
  int zok;
  testCaseTitle("TC-REQ-DIAG-002-01", "Manual check");
  testCaseComment("Manual check: With at least one known DTC stored, connect a diagnostic tester, issue a read-DTC request and check that the stored DTCs are returned correctly.");
  testStepPass("manual", "Not automated; checked by a person.");
}

/* TC-REQ-DIAG-003-01: Manual check
   Oracle (REQ-DIAG-003): The cluster shall perform a display self-test at startup
   Expected: Power up the cluster (IGN on) and watch the display (camera or by eye) to confirm the self-test sequence runs. Also confirm through a diagnostic tester or debug interface that the self-test executed. */
testcase TC_REQ_DIAG_003_01()
{
  long zt;
  int zok;
  testCaseTitle("TC-REQ-DIAG-003-01", "Manual check");
  testCaseComment("Manual check: Power up the cluster (IGN on) and watch the display (camera or by eye) to confirm the self-test sequence runs. Also confirm through a diagnostic tester or debug interface that the self-test executed.");
  testStepPass("manual", "Not automated; checked by a person.");
}

/* TC-REQ-GAUGE-002-01: Manual check
   Oracle (REQ-GAUGE-002): in km/h or mph according to the unit setting
   Expected: Feed a constant VehicleSpeed (e.g. from a simulator), switch the unit setting between km/h and mph in the cluster menu, and check visually that the display shows the correct value and unit label for e */
testcase TC_REQ_GAUGE_002_01()
{
  long zt;
  int zok;
  testCaseTitle("TC-REQ-GAUGE-002-01", "Manual check");
  testCaseComment("Manual check: Feed a constant VehicleSpeed (e.g. from a simulator), switch the unit setting between km/h and mph in the cluster menu, and check visually that the display shows the correct value and unit label for e");
  testStepPass("manual", "Not automated; checked by a person.");
}

/* TC-REQ-GAUGE-005-01: ClusterStatus every 100 ms
   Oracle (REQ-GAUGE-005): 4.3 The speed value shall be updated at least every 100 ms.
   Expected: 50 intervals of 100 ms ± 10 ms */
testcase TC_REQ_GAUGE_005_01()
{
  long zt;
  int zok;
  testCaseTitle("TC-REQ-GAUGE-005-01", "ClusterStatus every 100 ms");
  testCaseComment("Open value: tolerance not stated; cases allow ±10 ms (10 percent)");
  testWaitForTimeout(500);
  ZynCheckPeriod("ClusterStatus", 100, 10, 50);
}

/* TC-REQ-GAUGE-003-01: VehicleSpeed = 0 km/h
   Oracle (REQ-GAUGE-003): The displayed speed shall never be lower than the actual vehicle speed
   Expected: DisplayedSpeed within 0 .. - km/h after 220 ms */
testcase TC_REQ_GAUGE_003_01()
{
  long zt;
  int zok;
  testCaseTitle("TC-REQ-GAUGE-003-01", "VehicleSpeed = 0 km/h");
  testCaseComment("Open value: update time not stated; cases read the output 220 ms after the change (two status cycles plus one input cycle)");
  $VehicleSpeed = 150;
  testWaitForTimeout(500);
  $VehicleSpeed = 0;
  if (testWaitForSignalInRange(DisplayedSpeed, 0, 1e300, 220) == 1)
    testStepPass("check", "DisplayedSpeed at least 0");
  else
    testStepFail("check", "DisplayedSpeed not at least 0 within 220 ms");
}

/* TC-REQ-GAUGE-003-02: VehicleSpeed = 6 km/h
   Oracle (REQ-GAUGE-003): The displayed speed shall never be lower than the actual vehicle speed
   Expected: DisplayedSpeed within 6 .. - km/h after 220 ms */
testcase TC_REQ_GAUGE_003_02()
{
  long zt;
  int zok;
  testCaseTitle("TC-REQ-GAUGE-003-02", "VehicleSpeed = 6 km/h");
  testCaseComment("Open value: update time not stated; cases read the output 220 ms after the change (two status cycles plus one input cycle)");
  $VehicleSpeed = 150;
  testWaitForTimeout(500);
  $VehicleSpeed = 6;
  if (testWaitForSignalInRange(DisplayedSpeed, 6, 1e300, 220) == 1)
    testStepPass("check", "DisplayedSpeed at least 6");
  else
    testStepFail("check", "DisplayedSpeed not at least 6 within 220 ms");
}

/* TC-REQ-GAUGE-003-03: VehicleSpeed = 75 km/h
   Oracle (REQ-GAUGE-003): The displayed speed shall never be lower than the actual vehicle speed
   Expected: DisplayedSpeed within 75 .. - km/h after 220 ms */
testcase TC_REQ_GAUGE_003_03()
{
  long zt;
  int zok;
  testCaseTitle("TC-REQ-GAUGE-003-03", "VehicleSpeed = 75 km/h");
  testCaseComment("Open value: update time not stated; cases read the output 220 ms after the change (two status cycles plus one input cycle)");
  $VehicleSpeed = 150;
  testWaitForTimeout(500);
  $VehicleSpeed = 75;
  if (testWaitForSignalInRange(DisplayedSpeed, 75, 1e300, 220) == 1)
    testStepPass("check", "DisplayedSpeed at least 75");
  else
    testStepFail("check", "DisplayedSpeed not at least 75 within 220 ms");
}

/* TC-REQ-GAUGE-003-04: VehicleSpeed = 150 km/h
   Oracle (REQ-GAUGE-003): The displayed speed shall never be lower than the actual vehicle speed
   Expected: DisplayedSpeed within 150 .. - km/h after 220 ms */
testcase TC_REQ_GAUGE_003_04()
{
  long zt;
  int zok;
  testCaseTitle("TC-REQ-GAUGE-003-04", "VehicleSpeed = 150 km/h");
  testCaseComment("Open value: update time not stated; cases read the output 220 ms after the change (two status cycles plus one input cycle)");
  $VehicleSpeed = 0;
  testWaitForTimeout(500);
  $VehicleSpeed = 150;
  if (testWaitForSignalInRange(DisplayedSpeed, 150, 1e300, 220) == 1)
    testStepPass("check", "DisplayedSpeed at least 150");
  else
    testStepFail("check", "DisplayedSpeed not at least 150 within 220 ms");
}

/* TC-REQ-GAUGE-003-05: VehicleSpeed = 225 km/h
   Oracle (REQ-GAUGE-003): The displayed speed shall never be lower than the actual vehicle speed
   Expected: DisplayedSpeed within 225 .. - km/h after 220 ms */
testcase TC_REQ_GAUGE_003_05()
{
  long zt;
  int zok;
  testCaseTitle("TC-REQ-GAUGE-003-05", "VehicleSpeed = 225 km/h");
  testCaseComment("Open value: update time not stated; cases read the output 220 ms after the change (two status cycles plus one input cycle)");
  $VehicleSpeed = 150;
  testWaitForTimeout(500);
  $VehicleSpeed = 225;
  if (testWaitForSignalInRange(DisplayedSpeed, 225, 1e300, 220) == 1)
    testStepPass("check", "DisplayedSpeed at least 225");
  else
    testStepFail("check", "DisplayedSpeed not at least 225 within 220 ms");
}

/* TC-REQ-GAUGE-003-06: VehicleSpeed = 300 km/h
   Oracle (REQ-GAUGE-003): The displayed speed shall never be lower than the actual vehicle speed
   Expected: DisplayedSpeed within 300 .. - km/h after 220 ms */
testcase TC_REQ_GAUGE_003_06()
{
  long zt;
  int zok;
  testCaseTitle("TC-REQ-GAUGE-003-06", "VehicleSpeed = 300 km/h");
  testCaseComment("Open value: update time not stated; cases read the output 220 ms after the change (two status cycles plus one input cycle)");
  $VehicleSpeed = 150;
  testWaitForTimeout(500);
  $VehicleSpeed = 300;
  if (testWaitForSignalInRange(DisplayedSpeed, 300, 1e300, 220) == 1)
    testStepPass("check", "DisplayedSpeed at least 300");
  else
    testStepFail("check", "DisplayedSpeed not at least 300 within 220 ms");
}

/* TC-REQ-GAUGE-004-01: VehicleSpeed = 0 km/h
   Oracle (REQ-GAUGE-004): shall not exceed it by more than 10 percent plus 4 km/h
   Expected: DisplayedSpeed within - .. 4 km/h after 220 ms */
testcase TC_REQ_GAUGE_004_01()
{
  long zt;
  int zok;
  testCaseTitle("TC-REQ-GAUGE-004-01", "VehicleSpeed = 0 km/h");
  testCaseComment("Open value: update time not stated; cases read the output 220 ms after the change (two status cycles plus one input cycle)");
  $VehicleSpeed = 150;
  testWaitForTimeout(500);
  $VehicleSpeed = 0;
  if (testWaitForSignalInRange(DisplayedSpeed, -1e300, 4, 220) == 1)
    testStepPass("check", "DisplayedSpeed at most 4");
  else
    testStepFail("check", "DisplayedSpeed not at most 4 within 220 ms");
}

/* TC-REQ-GAUGE-004-02: VehicleSpeed = 6 km/h
   Oracle (REQ-GAUGE-004): shall not exceed it by more than 10 percent plus 4 km/h
   Expected: DisplayedSpeed within - .. 10.6 km/h after 220 ms */
testcase TC_REQ_GAUGE_004_02()
{
  long zt;
  int zok;
  testCaseTitle("TC-REQ-GAUGE-004-02", "VehicleSpeed = 6 km/h");
  testCaseComment("Open value: update time not stated; cases read the output 220 ms after the change (two status cycles plus one input cycle)");
  $VehicleSpeed = 150;
  testWaitForTimeout(500);
  $VehicleSpeed = 6;
  if (testWaitForSignalInRange(DisplayedSpeed, -1e300, 10.6, 220) == 1)
    testStepPass("check", "DisplayedSpeed at most 10.6");
  else
    testStepFail("check", "DisplayedSpeed not at most 10.6 within 220 ms");
}

/* TC-REQ-GAUGE-004-03: VehicleSpeed = 75 km/h
   Oracle (REQ-GAUGE-004): shall not exceed it by more than 10 percent plus 4 km/h
   Expected: DisplayedSpeed within - .. 86.5 km/h after 220 ms */
testcase TC_REQ_GAUGE_004_03()
{
  long zt;
  int zok;
  testCaseTitle("TC-REQ-GAUGE-004-03", "VehicleSpeed = 75 km/h");
  testCaseComment("Open value: update time not stated; cases read the output 220 ms after the change (two status cycles plus one input cycle)");
  $VehicleSpeed = 150;
  testWaitForTimeout(500);
  $VehicleSpeed = 75;
  if (testWaitForSignalInRange(DisplayedSpeed, -1e300, 86.5, 220) == 1)
    testStepPass("check", "DisplayedSpeed at most 86.5");
  else
    testStepFail("check", "DisplayedSpeed not at most 86.5 within 220 ms");
}

/* TC-REQ-GAUGE-004-04: VehicleSpeed = 150 km/h
   Oracle (REQ-GAUGE-004): shall not exceed it by more than 10 percent plus 4 km/h
   Expected: DisplayedSpeed within - .. 169 km/h after 220 ms */
testcase TC_REQ_GAUGE_004_04()
{
  long zt;
  int zok;
  testCaseTitle("TC-REQ-GAUGE-004-04", "VehicleSpeed = 150 km/h");
  testCaseComment("Open value: update time not stated; cases read the output 220 ms after the change (two status cycles plus one input cycle)");
  $VehicleSpeed = 0;
  testWaitForTimeout(500);
  $VehicleSpeed = 150;
  if (testWaitForSignalInRange(DisplayedSpeed, -1e300, 169, 220) == 1)
    testStepPass("check", "DisplayedSpeed at most 169");
  else
    testStepFail("check", "DisplayedSpeed not at most 169 within 220 ms");
}

/* TC-REQ-GAUGE-004-05: VehicleSpeed = 225 km/h
   Oracle (REQ-GAUGE-004): shall not exceed it by more than 10 percent plus 4 km/h
   Expected: DisplayedSpeed within - .. 251.5 km/h after 220 ms */
testcase TC_REQ_GAUGE_004_05()
{
  long zt;
  int zok;
  testCaseTitle("TC-REQ-GAUGE-004-05", "VehicleSpeed = 225 km/h");
  testCaseComment("Open value: update time not stated; cases read the output 220 ms after the change (two status cycles plus one input cycle)");
  $VehicleSpeed = 150;
  testWaitForTimeout(500);
  $VehicleSpeed = 225;
  if (testWaitForSignalInRange(DisplayedSpeed, -1e300, 251.5, 220) == 1)
    testStepPass("check", "DisplayedSpeed at most 251.5");
  else
    testStepFail("check", "DisplayedSpeed not at most 251.5 within 220 ms");
}

/* TC-REQ-GAUGE-004-06: VehicleSpeed = 300 km/h
   Oracle (REQ-GAUGE-004): shall not exceed it by more than 10 percent plus 4 km/h
   Expected: DisplayedSpeed within - .. 330 km/h after 220 ms */
testcase TC_REQ_GAUGE_004_06()
{
  long zt;
  int zok;
  testCaseTitle("TC-REQ-GAUGE-004-06", "VehicleSpeed = 300 km/h");
  testCaseComment("Open value: update time not stated; cases read the output 220 ms after the change (two status cycles plus one input cycle)");
  $VehicleSpeed = 150;
  testWaitForTimeout(500);
  $VehicleSpeed = 300;
  if (testWaitForSignalInRange(DisplayedSpeed, -1e300, 330, 220) == 1)
    testStepPass("check", "DisplayedSpeed at most 330");
  else
    testStepFail("check", "DisplayedSpeed not at most 330 within 220 ms");
}

/* TC-REQ-PWR-002-01-v2: IGN 1 -> 0
   Oracle (REQ-PWR-002): When IGN changes from ON to OFF, the cluster shall display the goodbye screen for 5 s and then enter the SLEEP state.
   Expected: ClusterState = 2 within 300 ms */
testcase TC_REQ_PWR_002_01_v2()
{
  long zt;
  int zok;
  testCaseTitle("TC-REQ-PWR-002-01-v2", "IGN 1 -> 0");
  testCaseComment("Open value: reaction time not stated; cases allow 300 ms (two status cycles plus one input cycle)");
  $IGN = 1;
  testWaitForTimeout(500);
  $IGN = 0;
  if (testWaitForSignalMatch(ClusterState, 2, 300) == 1)
    testStepPass("check", "ClusterState = 2 within 300 ms");
  else
    testStepFail("check", "ClusterState did not reach 2 within 300 ms");
}

/* TC-REQ-PWR-002-02-v2: ClusterState holds for 5000 ms
   Oracle (REQ-PWR-002): When IGN changes from ON to OFF, the cluster shall display the goodbye screen for 5 s and then enter the SLEEP state.
   Expected: ClusterState = 2 for 5000 ms, then ends */
testcase TC_REQ_PWR_002_02_v2()
{
  long zt;
  int zok;
  testCaseTitle("TC-REQ-PWR-002-02-v2", "ClusterState holds for 5000 ms");
  testCaseComment("Open value: reaction time not stated; cases allow 300 ms (two status cycles plus one input cycle)");
  $IGN = 1;
  testWaitForTimeout(500);
  $IGN = 0;
  testWaitForTimeout(300);
  zok = 1;
  for (zt = 0; zt <= 4600; zt += 10) { if (!($ClusterState == 2)) zok = 0; testWaitForTimeout(10); }
  if (zok) testStepPass("check", "ClusterState == 2 for 4600 ms");
  else testStepFail("check", "ClusterState == 2 did not hold for 4600 ms");
}

/* TC-REQ-PWR-002-03-v2: No IGN change
   Oracle (REQ-PWR-002): When IGN changes from ON to OFF, the cluster shall display the goodbye screen for 5 s and then enter the SLEEP state.
   Expected: ClusterState never shows 2 for 300 ms */
testcase TC_REQ_PWR_002_03_v2()
{
  long zt;
  int zok;
  testCaseTitle("TC-REQ-PWR-002-03-v2", "No IGN change");
  testCaseComment("Open value: reaction time not stated; cases allow 300 ms (two status cycles plus one input cycle)");
  $IGN = 1;
  testWaitForTimeout(500);
  zok = 1;
  for (zt = 0; zt <= 300; zt += 10) { if (!($ClusterState != 2)) zok = 0; testWaitForTimeout(10); }
  if (zok) testStepPass("check", "ClusterState != 2 for 300 ms");
  else testStepFail("check", "ClusterState != 2 did not hold for 300 ms");
}

/* TC-REQ-PWR-003-01-v2: IGN 1 -> 0
   Oracle (REQ-PWR-003): When IGN changes from ON to OFF, the cluster shall display the goodbye screen for 5 s and then enter the SLEEP state.
   Expected: ClusterState = 0 within 300 ms */
testcase TC_REQ_PWR_003_01_v2()
{
  long zt;
  int zok;
  testCaseTitle("TC-REQ-PWR-003-01-v2", "IGN 1 -> 0");
  testCaseComment("Open value: reaction time not stated; cases allow 300 ms (two status cycles plus one input cycle)");
  $IGN = 1;
  testWaitForTimeout(500);
  $IGN = 0;
  if (testWaitForSignalMatch(ClusterState, 0, 300) == 1)
    testStepPass("check", "ClusterState = 0 within 300 ms");
  else
    testStepFail("check", "ClusterState did not reach 0 within 300 ms");
}

/* TC-REQ-PWR-003-02-v2: No IGN change
   Oracle (REQ-PWR-003): When IGN changes from ON to OFF, the cluster shall display the goodbye screen for 5 s and then enter the SLEEP state.
   Expected: ClusterState never shows 0 for 300 ms */
testcase TC_REQ_PWR_003_02_v2()
{
  long zt;
  int zok;
  testCaseTitle("TC-REQ-PWR-003-02-v2", "No IGN change");
  testCaseComment("Open value: reaction time not stated; cases allow 300 ms (two status cycles plus one input cycle)");
  $IGN = 1;
  testWaitForTimeout(500);
  zok = 1;
  for (zt = 0; zt <= 300; zt += 10) { if (!($ClusterState != 0)) zok = 0; testWaitForTimeout(10); }
  if (zok) testStepPass("check", "ClusterState != 0 for 300 ms");
  else testStepFail("check", "ClusterState != 0 did not hold for 300 ms");
}

/* TC-REQ-PWR-005-01-v2: DoorOpen 0 -> 1
   Oracle (REQ-PWR-005): The cluster shall wake up within 300 ms when a door is opened.
   Expected: ClusterState = 1 within 300 ms */
testcase TC_REQ_PWR_005_01_v2()
{
  long zt;
  int zok;
  testCaseTitle("TC-REQ-PWR-005-01-v2", "DoorOpen 0 -> 1");
  $DoorOpen = 0;
  testWaitForTimeout(500);
  $DoorOpen = 1;
  if (testWaitForSignalMatch(ClusterState, 1, 300) == 1)
    testStepPass("check", "ClusterState = 1 within 300 ms");
  else
    testStepFail("check", "ClusterState did not reach 1 within 300 ms");
}

/* TC-REQ-PWR-005-02-v2: No DoorOpen change
   Oracle (REQ-PWR-005): The cluster shall wake up within 300 ms when a door is opened.
   Expected: ClusterState never shows 1 for 300 ms */
testcase TC_REQ_PWR_005_02_v2()
{
  long zt;
  int zok;
  testCaseTitle("TC-REQ-PWR-005-02-v2", "No DoorOpen change");
  $DoorOpen = 0;
  testWaitForTimeout(500);
  zok = 1;
  for (zt = 0; zt <= 300; zt += 10) { if (!($ClusterState != 1)) zok = 0; testWaitForTimeout(10); }
  if (zok) testStepPass("check", "ClusterState != 1 for 300 ms");
  else testStepFail("check", "ClusterState != 1 did not hold for 300 ms");
}

/* TC-REQ-TT-002-01-v2: VehicleSpeed one step above 25
   Oracle (REQ-TT-002): | Seat belt reminder | BeltUnfastened = 1 and vehicle speed above 25 km/h | Red | Flashing at 1 Hz |
   Expected: TT_Belt = 1 within 220 ms */
testcase TC_REQ_TT_002_01_v2()
{
  long zt;
  int zok;
  testCaseTitle("TC-REQ-TT-002-01-v2", "VehicleSpeed one step above 25");
  testCaseComment("Open value: reaction time not stated; cases allow 220 ms (two status cycles plus one input cycle)");
  $VehicleSpeed = 24.9;
  testWaitForTimeout(500);
  $VehicleSpeed = 25.01;
  if (testWaitForSignalMatch(TT_Belt, 1, 220) == 1)
    testStepPass("check", "TT_Belt = 1 within 220 ms");
  else
    testStepFail("check", "TT_Belt did not reach 1 within 220 ms");
}

/* TC-REQ-TT-002-02-v2: VehicleSpeed exactly 25
   Oracle (REQ-TT-002): | Seat belt reminder | BeltUnfastened = 1 and vehicle speed above 25 km/h | Red | Flashing at 1 Hz |
   Expected: TT_Belt stays 0 for 220 ms */
testcase TC_REQ_TT_002_02_v2()
{
  long zt;
  int zok;
  testCaseTitle("TC-REQ-TT-002-02-v2", "VehicleSpeed exactly 25");
  testCaseComment("Open value: reaction time not stated; cases allow 220 ms (two status cycles plus one input cycle)");
  $VehicleSpeed = 24.9;
  testWaitForTimeout(500);
  $VehicleSpeed = 25;
  zok = 1;
  for (zt = 0; zt <= 220; zt += 10) { if (!($TT_Belt == 0)) zok = 0; testWaitForTimeout(10); }
  if (zok) testStepPass("check", "TT_Belt == 0 for 220 ms");
  else testStepFail("check", "TT_Belt == 0 did not hold for 220 ms");
}

/* TC-REQ-TT-002-03-v2: VehicleSpeed one step on the other side
   Oracle (REQ-TT-002): | Seat belt reminder | BeltUnfastened = 1 and vehicle speed above 25 km/h | Red | Flashing at 1 Hz |
   Expected: TT_Belt stays 0 for 220 ms */
testcase TC_REQ_TT_002_03_v2()
{
  long zt;
  int zok;
  testCaseTitle("TC-REQ-TT-002-03-v2", "VehicleSpeed one step on the other side");
  testCaseComment("Open value: reaction time not stated; cases allow 220 ms (two status cycles plus one input cycle)");
  $VehicleSpeed = 24.9;
  testWaitForTimeout(500);
  $VehicleSpeed = 24.99;
  zok = 1;
  for (zt = 0; zt <= 220; zt += 10) { if (!($TT_Belt == 0)) zok = 0; testWaitForTimeout(10); }
  if (zok) testStepPass("check", "TT_Belt == 0 for 220 ms");
  else testStepFail("check", "TT_Belt == 0 did not hold for 220 ms");
}

/* TC-REQ-TT-002-04-v2: VehicleSpeed at range limit 300
   Oracle (REQ-TT-002): | Seat belt reminder | BeltUnfastened = 1 and vehicle speed above 25 km/h | Red | Flashing at 1 Hz |
   Expected: TT_Belt = 1 within 220 ms */
testcase TC_REQ_TT_002_04_v2()
{
  long zt;
  int zok;
  testCaseTitle("TC-REQ-TT-002-04-v2", "VehicleSpeed at range limit 300");
  testCaseComment("Open value: reaction time not stated; cases allow 220 ms (two status cycles plus one input cycle)");
  $VehicleSpeed = 24.9;
  testWaitForTimeout(500);
  $VehicleSpeed = 300;
  if (testWaitForSignalMatch(TT_Belt, 1, 220) == 1)
    testStepPass("check", "TT_Belt = 1 within 220 ms");
  else
    testStepFail("check", "TT_Belt did not reach 1 within 220 ms");
}

/* TC-REQ-COM-002-01-v3: Manual check
   Oracle (REQ-COM-002): If a CAN signal is not received for more than 500 ms, the cluster shall treat the signal as invalid.
   Expected: For a received message, stop sending it for 450 ms, then for 550 ms. Confirm the cluster treats its signals as invalid only in the second case, using the reaction defined for that signal (for example  */
testcase TC_REQ_COM_002_01_v3()
{
  long zt;
  int zok;
  testCaseTitle("TC-REQ-COM-002-01-v3", "Manual check");
  testCaseComment("Manual check: For a received message, stop sending it for 450 ms, then for 550 ms. Confirm the cluster treats its signals as invalid only in the second case, using the reaction defined for that signal (for example ");
  testStepPass("manual", "Not automated; checked by a person.");
}
